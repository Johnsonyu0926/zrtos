## tests/bluetooth/tester/boards/native_sim.conf
```kconfig
CONFIG_UART_PIPE=n
CONFIG_SERIAL=y
CONFIG_UART_NATIVE_POSIX=y
CONFIG_TEST_RANDOM_GENERATOR=y
```

## tests/subsys/pm/power_states/testcase.yaml
```yaml
# Copyright (c) 2024 Intel Corporation
# SPDX-License-Identifier: Apache-2.0

tests:
  pm.power_states:
    platform_allow:
      - stm32l562e_dk
    tags:
      - pm
    harness: pytest
    harness_config:
      pytest_dut_scope: session
      pytest_args: [--powershield=/dev/serial/by-id/usb-STMicroelectronics_PowerShield__Virtual_ComPort_in_FS_Mode__FFFFFFFEFFFF-if00]
```
